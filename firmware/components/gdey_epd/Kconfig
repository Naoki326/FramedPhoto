## firmware/components/gdey_epd/Kconfig
```kconfig
menu "GDEY EPD Driver"

    choice GDEY_EPD_SPI_HOST
        prompt "SPI host"
        default GDEY_EPD_SPI_HOST_SPI3
        help
            官方配套板使用 SPI3_HOST。

        config GDEY_EPD_SPI_HOST_SPI2
            bool "SPI2_HOST"
        config GDEY_EPD_SPI_HOST_SPI3
            bool "SPI3_HOST"
    endchoice

    config GDEY_EPD_SPI_HOST
        int
        default 1 if GDEY_EPD_SPI_HOST_SPI2
        default 2 if GDEY_EPD_SPI_HOST_SPI3

    config GDEY_EPD_SPI_SCLK
        int "SCLK GPIO"
        default 9

    config GDEY_EPD_SPI_MOSI
        int "MOSI (Data0) GPIO"
        default 41

    config GDEY_EPD_SPI_CLOCK_HZ
        int "SPI clock (Hz)"
        default 10000000
        range 1000000 40000000
        help
            官方示例使用 10MHz。

    config GDEY_EPD_PIN_CS0
        int "CS0 GPIO (IC0 / 右半屏)"
        default 18

    config GDEY_EPD_PIN_CS1
        int "CS1 GPIO (IC1 / 左半屏)"
        default 17

    config GDEY_EPD_PIN_RST
        int "RST GPIO"
        default 6

    config GDEY_EPD_PIN_BUSY
        int "BUSY GPIO"
        default 7

    config GDEY_EPD_PIN_LOAD_SW
        int "LOAD_SW GPIO (-1 = 无)"
        default 45
        range -1 48

endmenu
```

## firmware/main/Kconfig.projbuild
```kconfig
menu "FramedPhoto Application"

    config FRAMEDPHOTO_FW_VERSION
        string "Firmware version reported to server"
        default "0.1.0-dev"

    config FRAMEDPHOTO_WIFI_SSID
        string "WiFi SSID"
        default "your_ssid"
        help
            首次使用在 menuconfig 中填入，或运行时写入 NVS。

    config FRAMEDPHOTO_WIFI_PASSWORD
        string "WiFi password"
        default ""

    config FRAMEDPHOTO_SERVER_URL
        string "Service base URL"
        default "http://chenMac-mini.local:8010"
        help
            服务端根地址，后续内容拉取 / 状态上报 / OTA 均以此为前缀。
            支持两种写法：
            - mDNS 主机名（推荐）：http://<macOS LocalHostName>.local:8010
              如 http://chenMac-mini.local:8010。本机 LocalHostName 可通过
              `scutil --get LocalHostName` 查询。服务端 IP 变化（DHCP）时
              mDNS 自动指向新地址，无需改配置；sdkconfig 已启用
              CONFIG_LWIP_DNS_SUPPORT_MDNS_QUERIES，固件解析 .local 域名
              会自动发 mDNS 查询，无需额外初始化。
            - 固定 IP：http://192.168.x.x:8010（路由器给服务端绑定静态
              地址，或服务端配置固定 IP 时使用）。

    config FRAMEDPHOTO_POLL_INTERVAL_MIN
        int "Content poll interval (minutes)"
        default 30
        range 5 1440

    config FRAMEDPHOTO_DEEP_SLEEP_MIN
        int "Deep sleep interval (minutes, 0 = disabled)"
        default 30
        range 0 1440
        help
            显示更新完成后深度休眠的分钟数（RTC 定时器唤醒）。
            0 表示禁用（保持轮询，适合调试）。启用后设备每次唤醒
            检查内容，无变化则不刷屏直接再睡，实现长期续航。
            例：30 = 半小时唤醒一次，1440 = 每天一次。

    config FRAMEDPHOTO_BUTTON_GPIO
        int "Refresh button GPIO (-1 = disabled)"
        default -1
        range -1 21
        help
            按下立即拉取并刷新内容的按键。配套板只有三个按键：
            IO12 / IO13 / IO14（无 BOOT/RST 键）。
            默认 -1 禁用：仅靠内部上拉（≈45kΩ）休眠时易受干扰误触发刷新，
            若启用必须在硬件上外接 10kΩ 上拉电阻（低有效接法）并视需要
            并联 100nF 滤波电容（见 docs/hardware/gdeb0709e01.md）。
            仅 0-21（RTC GPIO）支持深度休眠 EXT1 唤醒；-1 禁用。

    config FRAMEDPHOTO_BUTTON_ACTIVE_LOW
        bool "Button is active-low (pressed to GND)"
        default y
        help
            按键按下时引脚电平。多数板子按键一端接 GND（按下为低，
            内部上拉即可）；若板子按键接 VCC（按下为高），关闭此项。
            电平不对的表现：按按键无反应或上电即误触发刷新。
            注意：若启用深度休眠，EXT1 唤醒电平会随之自动匹配。

endmenu
```

## firmware/sdkconfig.defaults
```kconfig
# 目标芯片：ESP32-S3（好视达配套板）
CONFIG_IDF_TARGET="esp32s3"

# 基础配置
CONFIG_PARTITION_TABLE_CUSTOM=y
CONFIG_PARTITION_TABLE_CUSTOM_FILENAME="partitions.csv"

# Flash：16MB（配套板），双 OTA + storage 图片分区
CONFIG_ESPTOOLPY_FLASHSIZE_16MB=y
CONFIG_ESPTOOLPY_FLASHSIZE="16MB"

# 调试
CONFIG_LOG_DEFAULT_LEVEL_INFO=y

# OTA 回滚：新固件首次启动须标记有效，否则 bootloader 自动切回旧分区
CONFIG_BOOTLOADER_APP_ROLLBACK_ENABLE=y

# 主任务栈适当放大，便于后续 HTTP 拉取
CONFIG_ESP_MAIN_TASK_STACK_SIZE=8192
CONFIG_ESP_WIFI_ENABLE_SMARTCONFIG=y

# 刷新按钮：按下立即拉取刷新（-1 = 禁用，默认禁用：休眠时易受干扰误触发）
CONFIG_FRAMEDPHOTO_BUTTON_GPIO=-1

# 服务端地址：mDNS 主机名（.local），服务端 IP 变化无需改配置
CONFIG_FRAMEDPHOTO_SERVER_URL="http://chenMac-mini.local:8010"
```
